## main/Kconfig.projbuild
```kconfig
menu "ESPNOWMIDIBridge Configuration"

    config ESPNOW_MIDI_ROOM_ID
        hex "Room ID for ESP-NOW Bridge"
        default 0x01
        help
            Compile-time constant identifying the room/zone for this bridge.
            Peers only join bridges with matching room ID.

    config ESPNOW_MIDI_WIFI_CHANNEL
        int "WiFi Channel for ESP-NOW"
        default 1
        range 1 13
        help
            WiFi channel used for ESP-NOW communication (1-13).
            All peers must use the same channel.

    config ESPNOW_MIDI_ADVERTISEMENT_INTERVAL_MS
        int "Advertisement Broadcast Interval (ms)"
        default 5000
        help
            Interval in milliseconds between bridge advertisements.
            Peers use this to discover the bridge.

    config ESPNOW_MIDI_PEER_TIMEOUT_MS
        int "Peer Timeout (ms)"
        default 30000
        help
            Time in milliseconds before a peer is considered inactive.
            Inactive peers are removed from the peer table.

    config ESPNOW_MIDI_STUCK_NOTE_TIMEOUT_MS
        int "Stuck Note Timeout (ms)"
        default 60000
        range 0 600000
        help
            Time in milliseconds before an active note is auto-released with Note Off.
            Set to 0 to disable stuck-note protection.

    config ESPNOW_MIDI_NOTE_KEEPALIVE_INTERVAL_MS
        int "Note Keepalive Timeout (ms)"
        default 100
        range 0 10000
        help
            Timeout in milliseconds for monitoring keepalive packets from clients.
            When a NOTE_ON is received, the bridge starts monitoring for keepalive packets.
            If no keepalive is received within this timeout, it counts as a missed keepalive.
            This prevents notes from being held forever if the client disconnects.
            Set to 0 to disable keepalive monitoring (rely only on stuck-note timeout).

    config ESPNOW_MIDI_KEEPALIVE_MISS_THRESHOLD
        int "Keepalive Miss Threshold"
        default 3
        range 1 20
        help
            Number of consecutive missed keepalives before a NOTE_OFF is generated.
            This provides tolerance for occasional WiFi packet loss.
            Higher values are more tolerant of lossy connections.
            Minimum value is 1 (generate NOTE_OFF after first miss).

    config ESPNOW_MIDI_MAX_PEERS
        int "Maximum Peer Count"
        default 10
        range 1 20
        help
            Maximum number of peers that can be in the peer table simultaneously.

    config ESPNOW_MIDI_ENABLE_DEBUG
        bool "Enable Debug Logging"
        default y
        help
            Enable detailed debug output for development and troubleshooting.

endmenu
```

## sdkconfig.defaults
```kconfig
# ESP-IDF Configuration Defaults for ESPNOWMIDIBridge

# Target device
CONFIG_IDF_TARGET="esp32c6"

# WiFi Configuration
CONFIG_ESP_WIFI_SSID=""
CONFIG_ESP_WIFI_PASSWORD=""
CONFIG_ESP_WIFI_MODE_STA=y

# ESP-NOW Configuration
CONFIG_ESP_NOW_ENABLE=y

# FreeRTOS Configuration
CONFIG_FREERTOS_USE_IDLE_HOOK=n
CONFIG_FREERTOS_USE_TICK_HOOK=n
CONFIG_FREERTOS_TICK_RATE_HZ=100

# USB Serial/JTAG Configuration
CONFIG_ESP_CONSOLE_UART_DEFAULT=n
CONFIG_ESP_CONSOLE_USB_SERIAL_JTAG=y
CONFIG_ESP_CONSOLE_USB_SERIAL_JTAG_BAUDRATE=115200

# Logging Configuration
CONFIG_LOG_DEFAULT_LEVEL=3
CONFIG_LOG_DEFAULT_LEVEL_INFO=y

# NVS Flash Configuration
CONFIG_NVS_ENCRYPTION=n

# Memory Configuration
CONFIG_ESP32C6_DEBUG_OCDAWARE=y

# Compiler Optimization
CONFIG_COMPILER_OPTIMIZATION_SIZE=y

# Minimal build
CONFIG_MINIMAL_BUILD=y

CONFIG_LD_ORPHAN_PLACE=y
```
